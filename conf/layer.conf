## conf/layer.conf
```bitbake
# We have a conf and classes directory, add to BBPATH
BBPATH .= ":${LAYERDIR}"

# We have recipes-* directories, add to BBFILES
BBFILES += "${LAYERDIR}/recipes-*/*/*.bb \
            ${LAYERDIR}/recipes-*/*/*.bbappend"

BBFILE_COLLECTIONS += "dpdk"
BBFILE_PATTERN_dpdk := "^${LAYERDIR}/"
BBFILE_PRIORITY_dpdk = "5"

LAYERDEPENDS_dpdk = "core"
LAYERRECOMMENDS_dpdk = "meta-dpdk-dl"

# This should only be incremented on significant changes that will
# cause compatibility issues with other layers
LAYERVERSION_dpdk = "1"
LAYERSERIES_COMPAT_dpdk = "hardknott"

NON_MULTILIB_RECIPES_append = " dpdk"
```
